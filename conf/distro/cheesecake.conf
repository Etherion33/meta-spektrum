## conf/distro/cheesecake.conf
```bitbake
# Cheesecake distribution policy for Spektrum devices.

DISTRO = "cheesecake"
DISTRO_NAME = "cheesecake"
DISTRO_VERSION = "1.0"

# Keep distro additions explicit without replacing upstream defaults.
DISTRO_FEATURES:append = " systemd wifi zeroconf usbgadget usbhost"
DISTRO_FEATURES:remove = "x11 wayland"
DISTRO_FEATURES_BACKFILL_CONSIDERED += "sysvinit"

require conf/distro/include/yocto-uninative.inc
require conf/distro/include/no-static-libs.inc
require conf/distro/include/cheesecake-spektrum.inc

INHERIT += "uninative"

INIT_MANAGER = "systemd"
VIRTUAL-RUNTIME_init_manager = "systemd"
VIRTUAL-RUNTIME_initscripts = ""
VIRTUAL-RUNTIME_dev_manager ?= "udev"

PACKAGE_CLASSES ?= "package_deb"
```

## conf/distro/include/cheesecake-spektrum.inc
```bitbake
# Spektrum distro-level defaults.
# Keep recipe logic simple by centralizing policy knobs here.

# Default Spektrum feature set for the meta package.
PACKAGECONFIG:pn-spektrum-sbc ??= "network streaming"

# Optional features can be toggled from distro/local config.
SPEKTRUM_ENABLE_OLED ?= "0"
SPEKTRUM_ENABLE_TAILSCALE ?= "0"

PACKAGECONFIG:append:pn-spektrum-sbc = "${@bb.utils.contains('SPEKTRUM_ENABLE_OLED', '1', ' oled', '', d)}"
PACKAGECONFIG:append:pn-spektrum-sbc = "${@bb.utils.contains('SPEKTRUM_ENABLE_TAILSCALE', '1', ' tailscale', '', d)}"

# Python package split defaults (override if your layer names differ).
SPEKTRUM_CORE_PYTHON_RDEPENDS ?= "python3-core python3-sqlite3 python3-websockets"
SPEKTRUM_OLED_PYTHON_RDEPENDS ?= "python3-core python3-sqlite3 python3-cbor2 python3-pillow python3-luma-oled"

# GStreamer package split defaults (override per distro/layer mix).
SPEKTRUM_STREAMING_RDEPENDS ?= "gstreamer1.0 gstreamer1.0-plugins-base gstreamer1.0-plugins-good gstreamer1.0-plugins-bad gstreamer1.0-plugins-ugly gstreamer1.0-libav v4l-utils"
```

## conf/layer.conf
```bitbake
# We have a conf and classes directory, add to BBPATH
BBPATH .= ":${LAYERDIR}"
BBFILES += "${LAYERDIR}/recipes-*/*/*.bb ${LAYERDIR}/recipes-*/*/*.bbappend"

BBFILE_COLLECTIONS += "spektrum"
BBFILE_PATTERN_spektrum = "^${LAYERDIR}/"
BBFILE_PRIORITY_spektrum = "8"

LAYERDEPENDS_spektrum = "core openembedded-layer meta-python meta-tailscale"
LAYERSERIES_COMPAT_spektrum = "scarthgap styhead walnascar"
```
